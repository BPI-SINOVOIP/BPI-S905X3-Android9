## bootloader/uboot-repo/bl33/board/amlogic/defconfigs/bananapi_m5_v1_defconfig
```kconfig
CONFIG_ARM=y
CONFIG_TARGET_MESON_G12A=y
CONFIG_BANANAPI_M5_V1=y
CONFIG_DM=y
CONFIG_DM_GPIO=y
CONFIG_AML_GPIO=y
```

## common/drivers/amlogic/shutdown_sysfs/Kconfig
```kconfig
config AMLOGIC_SHUTDOWN_SYSFS
	bool "amlogic soft shutdown sysfs support"
	default y
	help
	   Amlogic shutdown sysfs
```

## hardware/wifi/atbm/atbm602x/Kconfig
```kconfig
menuconfig ATBM_WIRELESS
	tristate "altobeam apollo sdio/usb WiFi"
	help
	  need SDIO/USB support, used mac80211/cfg80211

if ATBM_WIRELESS
source "drivers/net/wireless/atbm_wifi_40M/hal_apollo/Kconfig"
endif
```

## hardware/wifi/atbm/atbm602x/hal_apollo/Kconfig
```kconfig
config ATBM_APOLLO
       tristate "ATBM_APOLLO WLAN support"
       select ATBM_MAC80211
       help

         This is an experimental driver for the ATBM_APOLLO chip-set.
         Enabling this option enables the generic driver without
         any platform support.

         Please select the appropriate platform below.

if ATBM_APOLLO
choice
      prompt "select which atbm Wi-Fi product  will be used:ATBM601x,ATBM602x,default:ATBM602x"
      default ATBM602x
      depends on ATBM_APOLLO
      help
        Here,you must make sure which atbm Wi-Fi product you will want to use,ATBM601x,ATBM602x
config ATBM601x
      bool "ATBM601x chip"
      depends on ATBM_APOLLO
      help
        we will use ATBM601x chip
config ATBM602x
      bool "ATBM602x chip"
      depends on ATBM_APOLLO
      help
	we will use ATBM602x chip

endchoice

choice
      prompt "select which bus will be used"
      default ATBM_USB_BUS
      depends on ATBM_APOLLO
      help
        Here,you must make sure what interface you will want to use,usb
        sdio or spi
config ATBM_USB_BUS
      bool "usb bus"
      depends on ATBM_APOLLO
      help
        we will use usb bus
config ATBM_SDIO_BUS
      bool "sdio bus"
      depends on ATBM_APOLLO
      help

config ATBM_SPI_BUS
      bool "spi bus"
      depends on ATBM_APOLLO
      help
        we will use spi bus
endchoice

config ATBM_APOLLO_USE_GPIO_IRQ
      bool "Use GPIO interrupt"
      depends on ATBM_APOLLO && ATBM_SDIO_BUS
      default n
      help
        Say Y here if you want to include GPIO IRQ support instead of SDIO IRQ.
        If unsure, say N.
choice
      prompt "select which sido dpll freq used:24M or 40M.default:40M"
      default ATBM_SDIO_40M
      depends on ATBM_APOLLO && ATBM_SDIO_BUS
      help
        Here,you must make sure the sdio interface use 40M or 24M dpll
config ATBM_SDIO_40M
      bool "SDIO 40M"
      depends on ATBM_APOLLO && ATBM_SDIO_BUS
      help
        we will use SDIO 40M
config ATBM_SDIO_24M
      bool "SDIO 24M"
      depends on ATBM_APOLLO && ATBM_SDIO_BUS
      help
        we will use SDIO 24M

endchoice

config ATBM_APOLLO_WAPI_SUPPORT
      bool "WAPI support"
      depends on ATBM_APOLLO
      default n
      help
        Say Y if your compat-wireless support WAPI.
        If unsure, say N.



config ATBM_APOLLO_SUPPORT_SGI
      bool "Use short GI support"
      depends on ATBM_APOLLO
      default y
      help
        Say Y here if you want to include short gi support
        If unsure, say N.


menu "Driver debug features"
      depends on ATBM_APOLLO

config ATBM_APOLLO_DEBUGFS
      bool "Expose driver internals to DebugFS (DEVELOPMENT)"

config ATBM_APOLLO_DEBUG_ON_BOOT
      bool "Enable selected driver debug messages during boot time (DEVELOPMENT)"

config ATBM_APOLLO_BH_DEBUG
      bool "Enable low-level device communication logs (DEVELOPMENT)"

config ATBM_APOLLO_WSM_DEBUG
      bool "Enable WSM API debug messages (DEVELOPMENT)"

config ATBM_APOLLO_WSM_DUMPS
      bool "Verbose WSM API logging (DEVELOPMENT)"

config ATBM_APOLLO_WSM_DUMPS_SHORT
      bool "Dump only first x bytes (default 20) (DEVELOPMENT)"

config ATBM_APOLLO_TXRX_DEBUG
      bool "Enable TX/RX debug messages (DEVELOPMENT)"

config ATBM_APOLLO_TX_POLICY_DEBUG
      bool "Enable TX policy debug (DEVELOPMENT)"

config ATBM_APOLLO_STA_DEBUG
      bool "Enable STA/AP debug (DEVELOPMENT)"

config ATBM_APOLLO_DUMP_ON_ERROR
      bool "Dump kernel in case of critical error (DEVELOPMENT)"

endmenu
source "drivers/net/wireless/atbm_wifi_40M/hal_apollo/mac80211/Kconfig"
endif
```

## hardware/wifi/atbm/atbm602x/hal_apollo/mac80211/Kconfig
```kconfig
config ATBM_MAC80211
	tristate "Generic IEEE 802.11 Networking Stack (mac80211)"
	select CRYPTO
	select CRYPTO_ARC4
	select CRYPTO_AES
	select CRC32
	select AVERAGE
	---help---
	  This option enables the hardware independent IEEE 802.11
	  networking stack.

if ATBM_MAC80211 != n

config MAC80211_ATBM_HAS_RC
	bool

config MAC80211_ATBM_RC_PID
	bool "PID controller based rate control algorithm" if EXPERT
	select MAC80211_ATBM_HAS_RC
	---help---
	  This option enables a TX rate control algorithm for
	  mac80211 that uses a PID controller to select the TX
	  rate.

config MAC80211_ATBM_RC_MINSTREL
	bool "Minstrel" if EXPERT
	select MAC80211_ATBM_HAS_RC
	default y
	---help---
	  This option enables the 'minstrel' TX rate control algorithm

config MAC80211_ATBM_RC_MINSTREL_HT
	bool "Minstrel 802.11n support"
	depends on MAC80211_ATBM_RC_MINSTREL
	default y
	---help---
	  This option enables the 'minstrel_ht' TX rate control algorithm

choice
	prompt "Default rate control algorithm"
	depends on MAC80211_ATBM_HAS_RC
	default MAC80211_ATBM_RC_DEFAULT_MINSTREL
	---help---
	  This option selects the default rate control algorithm
	  mac80211 will use. Note that this default can still be
	  overridden through the ieee80211_default_rc_algo module
	  parameter if different algorithms are available.

config MAC80211_ATBM_RC_DEFAULT_PID
	bool "PID controller based rate control algorithm"
	depends on MAC80211_ATBM_RC_PID
	---help---
	  Select the PID controller based rate control as the
	  default rate control algorithm. You should choose
	  this unless you know what you are doing.

config MAC80211_ATBM_RC_DEFAULT_MINSTREL
	bool "Minstrel"
	depends on MAC80211_ATBM_RC_MINSTREL
	---help---
	  Select Minstrel as the default rate control algorithm.


endchoice

config MAC80211_ATBM_RC_DEFAULT
	string
	default "minstrel_ht" if MAC80211_ATBM_RC_DEFAULT_MINSTREL && MAC80211_ATBM_RC_MINSTREL_HT
	default "minstrel" if MAC80211_ATBM_RC_DEFAULT_MINSTREL
	default "pid" if MAC80211_ATBM_RC_DEFAULT_PID
	default ""

endif

comment "Some wireless drivers require a rate control algorithm"
	depends on ATBM_MAC80211 && MAC80211_ATBM_HAS_RC

config MAC80211_ATBM_NOINLINE
	bool "Do not inline TX/RX handlers"
	depends on MAC80211_ATBM_DEBUG_MENU
	---help---
	  This option affects code generation in mac80211, when
	  selected some functions are marked "noinline" to allow
	  easier debugging of problems in the transmit and receive
	  paths.

	  This option increases code size a bit and inserts a lot
	  of function calls in the code, but is otherwise safe to
	  enable.

	  If unsure, say N unless you expect to be finding problems
	  in mac80211.
```

## hardware/wifi/icomm/drivers/ssv6xxx/ssv6051/Kconfig
```kconfig
menu "SouthSV 6XXX WLAN support"
config SSV6XXX
	tristate "ssv6XXX Wireless driver"
	depends on MAC80211 && MMC
	---help---
		Enable SouthSV 6XXX WLAN kernel driver.

endmenu
```

## hardware/wifi/icomm/drivers/ssv6xxx/ssv6051/smac/firmware/defconfig/defconfig
```kconfig
##############################################################################
# Sample file for project configuration. This file will be copied
# to .config in the top directory and be parsed by genconf.sh to
# generate config.h
##############################################################################

CONFIG_TARGET = ssv6051
CONFIG_HCI = sw			# uart/spi/sdio/usb


#####################################################################
# BSP & CPU Configurations
#####################################################################
CONFIG_SYS_CLK = 40                     # CPU 40MHz
CONFIG_TICK_HZ = 100                    # 1 tick=100Hz=1ms
CONFIG_IRQ_STACK_SIZE = 256             # IRQ stack size
CONFIG_ENABLE_CPU_UART = y		# Enable/Disable CPU UART
CONFIG_CPU_UART_BR = 115200		# CPU UART Baud Rate


####################################################################
# Host and Controller interface Configurations (HCI)
# >> UART Configuration
####################################################################
CONFIG_HCI_UART_BR = 115200          	# UART Baud Rate



####################################################################
# CLI Configurations
####################################################################
CONFIG_CLI_ENABLE = y                   # Enable/Disable CLI
CONFIG_CLI_BUFFER_SIZE = 80             # CLI Buffer size
CONFIG_CLI_ARG_SIZE = 6                 # The number of arguments
CONFIG_CLI_PROMPT = "wifi> "



####################################################################
# TCP/IP Configurations
####################################################################
CONFIG_TCPIP_ENABLE = n



####################################################################
# WIFI Configurations
####################################################################
CONFIG_WLAN_AP_SUPPORT = n		# Enable/Disable AP mode support
CONFIG_WLAN_ADHOC_SUPPORT = n		# Enable/Disable Adhoc mode support
CONFIG_WLAN_MAX_BSS = 1			# The Number of BSSIDs support
CONFIG_WLAN_MAX_STA = 8			# The Number of STAs support
```
