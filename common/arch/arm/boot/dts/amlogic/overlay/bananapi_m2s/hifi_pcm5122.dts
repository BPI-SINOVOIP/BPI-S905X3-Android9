/dts-v1/;
/plugin/;

/ {
	fragment@0 {
		target = <&i2c2>;

		__overlay__ {
			status = "okay";

			pcm5122: pcm5122@4d {
				compatible = "ti,pcm5122";
				reg = <0x4d>;
				#sound-dai-cells = <0>;
				status = "okay";
			};
		};
	};
};
